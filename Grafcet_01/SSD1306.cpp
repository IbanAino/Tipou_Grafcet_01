

//-----------------------
//------ LIBRARIES ------
//-----------------------

#include "SSD1306.h"

// include I2C library
#include <Wire.h>



#define SSD1306_LCDWIDTH      128
#define SSD1306_LCDHEIGHT      64
#define SSD1306_SETCONTRAST   0x81
#define SSD1306_DISPLAYALLON_RESUME 0xA4
#define SSD1306_DISPLAYALLON 0xA5
#define SSD1306_NORMALDISPLAY 0xA6
#define SSD1306_INVERTDISPLAY 0xA7
#define SSD1306_DISPLAYOFF 0xAE
#define SSD1306_DISPLAYON 0xAF
#define SSD1306_SETDISPLAYOFFSET 0xD3
#define SSD1306_SETCOMPINS 0xDA
#define SSD1306_SETVCOMDETECT 0xDB
#define SSD1306_SETDISPLAYCLOCKDIV 0xD5
#define SSD1306_SETPRECHARGE 0xD9
#define SSD1306_SETMULTIPLEX 0xA8
#define SSD1306_SETLOWCOLUMN 0x00
#define SSD1306_SETHIGHCOLUMN 0x10
#define SSD1306_SETSTARTLINE 0x40
#define SSD1306_MEMORYMODE 0x20
#define SSD1306_COLUMNADDR 0x21
#define SSD1306_PAGEADDR   0x22
#define SSD1306_COMSCANINC 0xC0
#define SSD1306_COMSCANDEC 0xC8
#define SSD1306_SEGREMAP 0xA0
#define SSD1306_CHARGEPUMP 0x8D
#define SSD1306_EXTERNALVCC 0x1
#define SSD1306_SWITCHCAPVCC 0x2


//-----------------------
//------ VARIABLES ------
//-----------------------

uint8_t _i2c_address = 0x3C;

// Buffer with a picture saved on
static uint8_t buffer[1024] = {
  // 'Marianne, 128x64px
  0x20, 0x00, 0x00, 0x28, 0x40, 0x3f, 0xff, 0xff, 0xe0, 0x20, 0x00, 0x00, 0x00, 0x00, 0x04, 0x10, 
  0x8c, 0x00, 0x00, 0x10, 0x80, 0xbf, 0xff, 0xff, 0xc2, 0x40, 0x00, 0x00, 0x00, 0x00, 0x09, 0x8a, 
  0x20, 0x00, 0x01, 0x61, 0x00, 0x5f, 0xff, 0xff, 0xf0, 0x00, 0x00, 0x00, 0x20, 0x00, 0x04, 0x24, 
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  0x24, 0x00, 0x00, 0x00, 0x00, 0x47, 0xfa, 0x2c, 0x00, 0x00, 0x00, 0x03, 0xff, 0xff, 0xc8, 0x22
};


//-----------------------
//------ FUNCTIONS ------
//-----------------------

void ssd1306_command(uint8_t c) {
  // I2C
  uint8_t control = 0x00;   // Co = 0, D/C = 0
  Wire.beginTransmission(_i2c_address);
  //Wire.write(_i2c_address);
  Wire.write(control); // 0: the transmission of the following information will contain data bytes only. 
  Wire.write(c);
  Wire.endTransmission();
}

void screenDisplay(){
  for (uint16_t i = 0; i < 1024; i++) {
    // send a bunch of data in one xmission
    Wire.beginTransmission(_i2c_address);
    Wire.write(0x40); // data not command
    for (uint8_t x=0; x<16; x++) {
      Wire.write(buffer[i]);
      i++;
    }
    i--;
    Wire.endTransmission();
  }
}

void drawPixel(int16_t x, int16_t y) {
    buffer[x+ (y/8)*128] |=  (1 << (y&7));
}


void drawBitmap(int16_t x, int16_t y,
  const uint8_t bitmap[], int16_t w, int16_t h) {

    int16_t byteWidth = (w + 7) / 8; // Bitmap scanline pad = whole byte
    uint8_t byte = 0;

    for(int16_t j=0; j<h; j++, y++) {
        for(int16_t i=0; i<w; i++) {
            if(i & 7) byte <<= 1;
            else      byte   = pgm_read_byte(&bitmap[j * byteWidth + i / 8]);
            if(byte & 0x80) drawPixel(x+i, y);
        }
    }
}



// clear everything
void clearDisplay() {
  memset(buffer, 0, (SSD1306_LCDWIDTH*SSD1306_LCDHEIGHT/8));
}

// init according to SSD1306 data sheet and many places on the web
void  InitializeDisplay()
{
    // reset
    /*
    output_high(DISPLAY_RESET);
    delay_ms(1);
    output_low(DISPLAY_RESET);
    delay_ms(10);
    output_high(DISPLAY_RESET); // Reset Pin High for normal operation
    */
   
   
    // Init sequence for 128x64 OLED module
    ssd1306_command(SSD1306_DISPLAYOFF);                    // 0xAE

    ssd1306_command(SSD1306_SETDISPLAYCLOCKDIV);            // 0xD5
    ssd1306_command(0x80);                 // the suggested ratio 0x80
   
    ssd1306_command(SSD1306_SETMULTIPLEX);                  // 0xA8
    ssd1306_command(0x3F);
   
    ssd1306_command(SSD1306_SETDISPLAYOFFSET);              // 0xD3
    ssd1306_command(0x0);                                   // no offset
   
    ssd1306_command(SSD1306_SETSTARTLINE);// | 0x0);        // line #0
   
    ssd1306_command(SSD1306_CHARGEPUMP);                    // 0x8D
    ssd1306_command(0x14);  // using internal VCC
   
    ssd1306_command(SSD1306_MEMORYMODE);                    // 0x20
    ssd1306_command(0x00);          // 0x00 horizontal addressing
   
    ssd1306_command(SSD1306_SEGREMAP | 0x1); // rotate screen 180
   
    ssd1306_command(SSD1306_COMSCANDEC); // rotate screen 180
   
    ssd1306_command(SSD1306_SETCOMPINS);                    // 0xDA
    ssd1306_command(0x12);
   
    ssd1306_command(SSD1306_SETCONTRAST);                   // 0x81
    ssd1306_command(0xCF);
   
    ssd1306_command(SSD1306_SETPRECHARGE);                  // 0xd9
    ssd1306_command(0xF1);
   
    ssd1306_command(SSD1306_SETVCOMDETECT);                 // 0xDB
    ssd1306_command(0x40);
   
    ssd1306_command(SSD1306_DISPLAYALLON_RESUME);           // 0xA4
   
    ssd1306_command(SSD1306_NORMALDISPLAY);                 // 0xA6
 
    ssd1306_command(SSD1306_DISPLAYON);                     //switch on OLED
}
